## Documentation/devicetree/bindings/gpio/gpio-aspeed.txt
```
Aspeed GPIO controller Device Tree Bindings
-------------------------------------------

Required properties:
- #gpio-cells 		: Should be two
			  - First cell is the GPIO line number
			  - Second cell is used to specify optional
			    parameters (unused)

- compatible		: Either "aspeed,ast2400-gpio" or "aspeed,ast2500-gpio"

- reg			: Address and length of the register set for the device
- gpio-controller	: Marks the device node as a GPIO controller.
- interrupts		: Interrupt specifier (see interrupt bindings for
			  details)

Optional properties:
- interrupt-controller	: Marks the device node as an interrupt controller.
- interrupt-parent	: The parent interrupt controller, optional if inherited
- #interrupt-cells 	: Should be 2.  The first cell is the GPIO number.
			  The second cell bits[3:0] is used to specify trigger
			  type and level flags:
			      1 = low-to-high edge triggered.
			      2 = high-to-low edge triggered.
			      4 = active high level-sensitive.
			      8 = active low level-sensitive.

The gpio and interrupt properties are further described in their respective
bindings documentation:

- Documentation/devicetree/bindings/gpio/gpio.txt
- Documentation/devicetree/bindings/interrupt-controller/interrupts.txt

  Example:
	gpio@1e780000 {
		#gpio-cells = <2>;
		compatible = "aspeed,ast2400-gpio"
		gpio-controller;
		interrupt-parent = <&intc>;
		interrupts = <20>;
		reg = <0x1e780000 0x1000>;
	};
```

## Documentation/devicetree/bindings/hwmon/occ.txt
```
* BMC OCC Sensor HWMON driver.

Required node properties:
- compatible: manufacturer and chip name
		"ibm,occ-i2c"

- reg: I2C bus address of the device

Example occ node:

occ@50 {
	compatible = "ibm,occ-i2c";
	reg = <0x50>;
}
```

## Documentation/devicetree/bindings/i2c/i2c-ibm-occ.txt
```
BMC I2C driver for IBM POWER CPU OCC (On-Chip-Controller)

Required properties:
 - compatible: must be "ibm,occ-i2c"
 - reg: physical address

Example:
i2c3: i2c-bus@100 {
	occ@50 {
		compatible = "ibm,occ-i2c";
		reg = <0x50>;
	};
};
```

## Documentation/devicetree/bindings/mtd/aspeed-smc.txt
```
* Aspeed Static Memory controller in SPI mode
* Aspeed SPI Flash Controller

Required properties:
  - compatible : Should be "aspeed,fmc" for Static Memory Controller (AST2400, AST2300?), or
		 "aspeed,smc" for the SPI flash controller
  - reg : the first contains the register location and length,
          the second through nth contains the memory mapping address and length
	  for the access window for each chips select
  - interrupts : Should contain the interrupt for the dma device if fmc
  - clocks : The APB clock input to the controller
  - #address-cells : must be 1 corresponding to chip select child binding
  - #size-cells : must be 0 corresponding to chip select child binding


Child node required properties:
  - reg : must contain chip select number in first cell of address, must
	  be 1 tuple long
  - compatible : may contain "vendor,part", must include "jedec,spi-nor"
		(see spi-nor.txt binding).

Child node optional properties:
  - spi-max-frequency - (optional) max frequency of spi bus (XXX max if missing)
  - spi-cpol        - (optional) Empty property indicating device requires
    	 		inverse clock polarity (CPOL) mode (boolean)
  - spi-cpha        - (optional) Empty property indicating device requires
    			shifted clock phase (CPHA) mode (boolean)
  - spi-tx-bus-width - (optional) The bus width(number of data wires) that
                        used for MOSI. Defaults to 1 if not present.
  - spi-rx-bus-width - (optional) The bus width(number of data wires) that
                        used for MOSI. Defaults to 1 if not present.

Child node optional properties:
 - see mtd/partiton.txt for partitioning bindings and mtd naming


Example:

fmc: fmc@1e620000 {
	compatible = "aspeed,fmc";
	reg = < 0x1e620000 0x94
		0x20000000 0x02000000
		0x22000000 0x02000000 >;
	#address-cells = <1>;
	#size-cells = <0>;
	bmc@0 {
		reg = < 0 >;
		compatible = "jedec,spi-nor" ;
		label = "bmc0";
		/* spi-max-frequency = <>; */
		/* m25p,fast-read; */
		#address-cells = <1>;
		#size-cells = <1>;
			bootloader {
				label = "boot";
				reg = < 0 0x8000 >
			}
	};
	alt@1 {
		reg = < 1 >;
		compatible = "jedec,spi-nor" ;
		label = "bmc1";
		/* spi-max-frequency = <>; */
		status = "fail";
		/* m25p,fast-read; */
	};
};
```

## arch/arm/mach-aspeed/Kconfig
```kconfig
menuconfig ARCH_ASPEED
	bool "ASpeed BMC SoCs" if ARCH_MULTI_V5
	select CPU_ARM926T
	select CLKSRC_MMIO
	select GENERIC_IRQ_CHIP
	select ARCH_REQUIRE_GPIOLIB
	select PINCTRL
	select PINCTRL_ASPEED
	select PHYLIB if NETDEVICES
	select MFD_SYSCON
	select SRAM
	help
	  Say Y here if you want to run your kernel on hardware with an
	  ASpeed BMC SoC. Tested on AST2400

if ARCH_ASPEED

config MACH_OPP_PALMETTO_BMC
	bool "OpenPower Palmetto"
	depends on ARCH_ASPEED
	select RTC_DRV_ASPEED
	help
	  Say Y here if you intend to run this kernel on the BMC
	  of an OpenPower "Palmetto" eval board

endif
```

## arch/arm64/configs/ax3000_defconfig
```kconfig
CONFIG_SYSVIPC=y
CONFIG_PREEMPT=y
CONFIG_BSD_PROCESS_ACCT=y
CONFIG_BSD_PROCESS_ACCT_V3=y
CONFIG_IKCONFIG=y
CONFIG_IKCONFIG_PROC=y
CONFIG_CGROUPS=y
CONFIG_NAMESPACES=y
CONFIG_USER_NS=y
CONFIG_BLK_DEV_INITRD=y
CONFIG_EXPERT=y
CONFIG_KALLSYMS_ALL=y
CONFIG_KEXEC=y
CONFIG_KEXEC_FILE=y
CONFIG_CRASH_DUMP=y
CONFIG_ARCH_AXIADO=y
CONFIG_ARM64_VA_BITS_48=y
CONFIG_NR_CPUS=4
# CONFIG_RODATA_FULL_DEFAULT_ENABLED is not set
# CONFIG_ARM64_TAGGED_ADDR_ABI is not set
CONFIG_COMPAT=y
# CONFIG_ARM64_RAS_EXTN is not set
# CONFIG_ARM64_CNP is not set
# CONFIG_ARM64_PTR_AUTH is not set
# CONFIG_ARM64_AMU_EXTN is not set
# CONFIG_ARM64_BTI is not set
# CONFIG_ARM64_E0PD is not set
# CONFIG_ARM64_EPAN is not set
# CONFIG_ARM64_SVE is not set
# CONFIG_EFI is not set
CONFIG_JUMP_LABEL=y
# CONFIG_SECCOMP is not set
# CONFIG_COMPAT_32BIT_TIME is not set
CONFIG_MODULES=y
CONFIG_MODULE_UNLOAD=y
# CONFIG_BLK_DEBUG_FS is not set
CONFIG_IOSCHED_BFQ=y
# CONFIG_CORE_DUMP_DEFAULT_ELF_HEADERS is not set
# CONFIG_COMPAT_BRK is not set
CONFIG_PAGE_REPORTING=y
CONFIG_MEMORY_FAILURE=y
CONFIG_TRANSPARENT_HUGEPAGE=y
CONFIG_DEVTMPFS=y
CONFIG_DEVTMPFS_MOUNT=y
CONFIG_FW_LOADER_USER_HELPER=y
CONFIG_FW_LOADER_USER_HELPER_FALLBACK=y
# CONFIG_ARM_SMCCC_SOC_ID is not set
# CONFIG_BLK_DEV is not set
CONFIG_INPUT_FF_MEMLESS=y
CONFIG_INPUT_MATRIXKMAP=y
CONFIG_INPUT_EVDEV=y
# CONFIG_SERIO_SERPORT is not set
CONFIG_SERIO_AMBAKMI=y
CONFIG_USERIO=y
CONFIG_VT_HW_CONSOLE_BINDING=y
CONFIG_LEGACY_PTY_COUNT=16
CONFIG_SERIAL_XILINX_PS_UART=y
CONFIG_SERIAL_XILINX_PS_UART_CONSOLE=y
CONFIG_SERIAL_DEV_BUS=y
CONFIG_IPMI_HANDLER=y
# CONFIG_HW_RANDOM is not set
CONFIG_GPIO_SYSFS=y
CONFIG_GPIO_CADENCE=y
CONFIG_POWER_RESET_XGENE=y
CONFIG_POWER_RESET_SYSCON=y
CONFIG_SYSCON_REBOOT_MODE=y
# CONFIG_HWMON is not set
# CONFIG_HID_SUPPORT is not set
CONFIG_USB=y
CONFIG_USB_XHCI_HCD=y
CONFIG_USB_XHCI_DBGCAP=y
CONFIG_USB_XHCI_PLATFORM=y
CONFIG_RTC_CLASS=y
# CONFIG_RTC_NVMEM is not set
CONFIG_RTC_DRV_CADENCE=y
# CONFIG_VIRTIO_MENU is not set
# CONFIG_VHOST_MENU is not set
# CONFIG_SURFACE_PLATFORMS is not set
CONFIG_HWSPINLOCK=y
# CONFIG_IOMMU_SUPPORT is not set
CONFIG_REMOTEPROC=y
CONFIG_RESET_CONTROLLER=y
CONFIG_GENERIC_PHY=y
# CONFIG_DNOTIFY is not set
# CONFIG_INOTIFY_USER is not set
CONFIG_MSDOS_FS=y
CONFIG_VFAT_FS=y
CONFIG_PROC_KCORE=y
CONFIG_TMPFS=y
CONFIG_HUGETLBFS=y
CONFIG_CONFIGFS_FS=y
CONFIG_NLS_CODEPAGE_437=y
CONFIG_NLS_ISO8859_1=y
CONFIG_KEYS=y
CONFIG_SECURITY=y
CONFIG_LSM="landlock,lockdown,yama,loadpin,safesetid,integrity,bpf"
CONFIG_INIT_STACK_NONE=y
# CONFIG_CRYPTO_MANAGER_DISABLE_TESTS is not set
CONFIG_CRYPTO_CBC=y
CONFIG_CRYPTO_ECB=y
CONFIG_CRYPTO_CCM=y
CONFIG_CRYPTO_GCM=y
CONFIG_CRYPTO_SEQIV=y
CONFIG_CRYPTO_ECHAINIV=y
CONFIG_CRYPTO_CMAC=y
CONFIG_CRYPTO_MD5=y
CONFIG_CRYPTO_SHA1=y
CONFIG_CRYPTO_CRC32C=y
CONFIG_CRYPTO_DEFLATE=y
# CONFIG_CRYPTO_HW is not set
CONFIG_CRC16=y
CONFIG_DYNAMIC_DEBUG=y
# CONFIG_DEBUG_MISC is not set
CONFIG_DEBUG_INFO_DWARF_TOOLCHAIN_DEFAULT=y
CONFIG_MAGIC_SYSRQ=y
CONFIG_DEBUG_FS=y
# CONFIG_SCHED_DEBUG is not set
# CONFIG_FTRACE is not set
# CONFIG_STRICT_DEVMEM is not set
# CONFIG_RUNTIME_TESTING_MENU is not set
CONFIG_MEMTEST=y
```

## net/ncsi/Kconfig
```kconfig
#
# Configuration for NCSI support
#

config NET_NCSI
	bool "NCSI interface support (EXPERIMENTAL)"
	depends on INET
	---help---
	  This module provides NCSI (Network Controller Sideband Interface)
	  support.
```
